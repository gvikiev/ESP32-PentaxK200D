## main/Kconfig.projbuild
```kconfig
menu "PentaxHub Configuration"

    config PENTAXHUB_AP_SSID
        string "WiFi access point SSID"
        default "PentaxHub"
        help
            Name of the WiFi network the ESP32-S3 creates. Connect to it
            from a phone/laptop, then open http://192.168.4.1/.

    config PENTAXHUB_AP_PASSWORD
        string "WiFi access point password"
        default "pentaxhub"
        help
            WPA2 password for the access point (8-63 characters).
            Leave empty for an open (unencrypted) network.

    config PENTAXHUB_AP_CHANNEL
        int "WiFi channel"
        range 1 13
        default 6

    config PENTAXHUB_AP_MAX_CONN
        int "Maximum simultaneous WiFi clients"
        range 1 10
        default 4

    config PENTAXHUB_HTTP_PORT
        int "HTTP server port"
        default 80

    config PENTAXHUB_USB_BULK_BUFFER_SIZE
        int "USB bulk transfer buffer size (bytes)"
        default 8192
        range 512 32768
        help
            Size of the bulk IN/OUT transfer buffers used for PTP traffic
            with the camera. Must be a multiple of 64. Larger values
            reduce the number of USB transactions needed to move a photo
            off the camera, at the cost of more internal RAM.

    config PENTAXHUB_USB_DAEMON_TASK_PRIO
        int "USB host library daemon task priority"
        default 5

    choice PENTAXHUB_BACKEND
        prompt "Camera protocol backend"
        default PENTAXHUB_BACKEND_PENTAX_SCSI
        help
            PTP: original stage-1 backend (camera in [PictBridge] mode).
            Pentax SCSI: stage-2 backend, USB Mass Storage Bulk-Only
            transport carrying Pentax vendor SCSI commands (camera in
            [PC] mode). Only one backend is built into the firmware.

        config PENTAXHUB_BACKEND_PTP
            bool "Standard PTP (PictBridge mode)"

        config PENTAXHUB_BACKEND_PENTAX_SCSI
            bool "Pentax SCSI over USB MSC/BOT (PC mode)"
    endchoice

    config PENTAXHUB_STREAM_BLOCK_SIZE
        int "Photo stream block size (bytes)"
        depends on PENTAXHUB_BACKEND_PENTAX_SCSI
        default 16384
        range 4096 65536
        help
            Size of each PSRAM block between the USB reader and the HTTP
            sender. Should be a multiple of 64.

    config PENTAXHUB_STREAM_BLOCKS
        int "Photo stream block count"
        depends on PENTAXHUB_BACKEND_PENTAX_SCSI
        default 8
        range 2 64
        help
            Number of blocks in the bounded queue. PSRAM use is
            block size x block count; a slow Wi-Fi client stalls the
            USB reader rather than growing memory.

    config PENTAXHUB_PENTAX_BUF_TYPE
        int "Pentax select-buffer type"
        depends on PENTAXHUB_BACKEND_PENTAX_SCSI
        default 0
        help
            Second argument of the Select Buffer command (image format
            to read out). UNVERIFIED on a K200D; adjust after testing.

    config PENTAXHUB_PENTAX_BUF_RES
        int "Pentax select-buffer resolution"
        depends on PENTAXHUB_BACKEND_PENTAX_SCSI
        default 0
        help
            Third argument of the Select Buffer command. UNVERIFIED.

endmenu
```

## sdkconfig.defaults
```kconfig
CONFIG_ESP_WIFI_SOFTAP_SUPPORT=y
CONFIG_HTTPD_WS_SUPPORT=y
CONFIG_PENTAXHUB_BACKEND_PENTAX_SCSI=y
```
